#include <dt-bindings/zmk/matrix_transform.h>

/ {
    chosen {
        zmk,kscan = &default_kscan;
        zmk,matrix_transform = &default_transform
        zmk,physical-layout = &default_layout
    }

    default_kscan: kscan {
        compatible = "zmk,kscan-gpio-matrix";
        label = "default_kscan";
        diode-direction = "col2row";
        wakeup-source;

        row-gpios
            = <&pro_micro 2 (GPIO_ACTIVE_HIGH | GPIO_PULL_DOWN)>,
              <&pro_micro 3 (GPIO_ACTIVE_HIGH | GPIO_PULL_DOWN)>,
              <&pro_micro 4 (GPIO_ACTIVE_HIGH | GPIO_PULL_DOWN)>,
              <&pro_micro 21 (GPIO_ACTIVE_HIGH | GPIO_PULL_DOWN)>;

        col-gpios
            = <&pro_micro 5 GPIO_ACTIVE_HIGH>,
              <&pro_micro 6 GPIO_ACTIVE_HIGH>,
              <&pro_micro 7 GPIO_ACTIVE_HIGH>,
              <&pro_micro 8 GPIO_ACTIVE_HIGH>,
              <&pro_micro 9 GPIO_ACTIVE_HIGH>,
              <&pro_micro 20 GPIO_ACTIVE_HIGH>,
              <&pro_micro 19 GPIO_ACTIVE_HIGH>,
              <&pro_micro 18 GPIO_ACTIVE_HIGH>;
    };

    default_transform: matrix_transform {
        compatible = "zmk,matrix-transform";
        columns = <16>;
        rows = <4>;
        map = <
            RC(0,0) RC(0,1) RC(0,2) RC(0,3) RC(0,4)                                 RC(0,11) RC(0,12) RC(0,13) RC(0,14) RC(0,15)
            RC(1,0) RC(1,1) RC(1,2) RC(1,3) RC(1,4)                                 RC(1,11) RC(1,12) RC(1,13) RC(1,14) RC(1,15)
            RC(2,0) RC(2,1) RC(2,2) RC(2,3) RC(2,4)                                 RC(2,11) RC(2,12) RC(2,13) RC(2,14) RC(2,15)
                                            RC(3,5) RC(3,6) RC(3,7)     RC(3,8) RC(3,9) RC(3,10)

    defualt_layout: physical_layout {
        compatible = "zmk,physical-layout"
        display-name = "default layout"
        transform = <&default_transform>;
        };
    }; 
};