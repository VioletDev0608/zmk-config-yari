## boards/shields/yari/Kconfig.defconfig
```kconfig
if SHIELD_YARI

config ZMK_KEYBOARD_NAME
    default "yari"

config ZMK_SPLIT_ROLE_CENTRAL
    default y

endif

if SHIELD_YARI_LEFT || SHIELD_YARI_RIGHT

config ZMK_SPLIT
    default y

endif
```

## boards/shields/yari/Kconfig.shield
```kconfig
config SHIELD_YARI_LEFT
    def_bool $(shields_list_contains, yari_left)

config SHIELD_YARI_RIGHT
    def_bool $(shields_list_contains, yari_right)
```
